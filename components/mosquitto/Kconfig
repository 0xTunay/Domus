## components/mosquitto/Kconfig
```kconfig
menu "MQTT Configuration"

    config BROKER_URL
        string "Broker URL"
        default "mqtt://192.168.100.84:1883"
        help
            URL of the broker to connect to

    config MQTT_USERNAME
        string "MQTT username"
        default "iot"
        help
            Username for MQTT broker authentication

    config MQTT_PASSWORD
        string "MQTT password"
        default "mosquitto"
        help
            Password for MQTT broker authentication

endmenu
```

## components/wifi_manager/Kconfig
```kconfig
menu "WiFi Manager Configuration"
    config WIFI_SSID
        string "WiFi SSID"
        default "zte08"
        help
            SSID (network name) to connect to.
    config WIFI_PASS
        string "WiFi Password"
        default "23021921k"
        help
            WiFi password (WPA or WPA2).
    config MAXIMUM_RETRY
        int "Maximum retry count"
        default 5
        help
            Number of times to retry connecting before giving up.
endmenu
```

## main/Kconfig.projbuild
```kconfig
menu "MQTT Configuration"

    config BROKER_URL
        string "Broker URL"
        default "mqtt://192.168.100.84:1883"
        help
            URL of the broker to connect to

endmenu
```
